## Kconfig
```kconfig
config ZMK_RGB_EXT
    bool "Enable ZMK RGB extension"
    default y
    depends on DT_HAS_ZMK_RGB_EXT_ENABLED

if ZMK_RGB_EXT

# Types must be explicitly declared for each symbol
config SPI
    bool "Use SPI for RGB extension communication"
    default y

config ZMK_RGB_EXT_EXT_POWER
    bool "Enable external power for RGB extension"
    default y

config ZMK_RGB_EXT_BRT_MIN
    int "Minimum brightness for RGB extension"
    default 0

config ZMK_RGB_EXT_BRT_MAX
    int "Maximum brightness for RGB extension"
    default 100

config ZMK_RGB_EXT_HUE_STEP
    int "Hue step for RGB extension"
    default 10

config ZMK_RGB_EXT_SAT_STEP
    int "Saturation step for RGB extension"
    default 10

config ZMK_RGB_EXT_BRT_STEP
    int "Brightness step for RGB extension"
    default 10

config ZMK_RGB_EXT_HUE_START
    int "Starting hue for RGB extension"
    default 0

config ZMK_RGB_EXT_SAT_START
    int "Starting saturation for RGB extension"
    default 100

config ZMK_RGB_EXT_BRT_START
    int "Starting brightness for RGB extension"
    default 100

config ZMK_RGB_EXT_SPD_START
    int "Starting speed for RGB extension"
    default 3

config ZMK_RGB_EXT_EFF_START
    int "Starting effect for RGB extension"
    default 0

config ZMK_RGB_EXT_ON_START
    bool "Starting state for RGB extension"
    default y

config ZMK_RGB_EXT_AUTO_OFF_IDLE
    bool "Auto-off idle for RGB extension"
    default y

config ZMK_RGB_EXT_AUTO_OFF_USB
    bool "Auto-off USB suspend for RGB extension"
    default y

endif #ZMK_RGB_EXT




config ZMK_BEHAVIOR_RGB_EXT
    bool
    default y
    depends on DT_HAS_ZMK_BEHAVIOR_RGB_EXT_ENABLED

if ZMK_BEHAVIOR_RGB_EXT

endif #ZMK_BEHAVIOR_RGB_EXT
```

## dts/bindings/behaviors/zmk,behavior-rgb-ext.yaml
```yaml
# Copyright (c) 2020 The ZMK Contributors
# SPDX-License-Identifier: MIT

description: RGB Extended

compatible: "zmk,behavior-rgb-ext"

include: two_param.yaml
```

## dts/bindings/zmk,rgb-ext.yaml
```yaml
#description: Custom RGB Extension Module
#compatible: "zmk,rgb-ext"
#properties:
#  rgb-dev:
#    type: phandle
#    required: true
#    description: Phandle to the underlying led-strip device
```
